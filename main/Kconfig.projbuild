## main/Kconfig.projbuild
```kconfig
menu "OCTO Radio"

    choice RADIO_OCTOPUS_QUALITY
        prompt "Main page octopus scene"
        default RADIO_OCTOPUS_QUALITY_FULL
        help
            How much work the animated octopus on the main page does per frame.

            Full draws every layer as designed. Lite keeps the same scene, the
            same animation and the same frame rate target, and spends less time
            per frame by shading each arm with 3 bands instead of 6 and placing
            them further apart. It differs from Full only in the smoothness of
            the arm shading. Choose Lite if Full does not reach a steady frame
            rate on the device, or if audio glitches while it runs.

            Off shows the plain water background with no octopus, for finding
            out whether the scene is the cause of a problem.

        config RADIO_OCTOPUS_QUALITY_FULL
            bool "Full"

        config RADIO_OCTOPUS_QUALITY_LITE
            bool "Lite"

        config RADIO_OCTOPUS_QUALITY_OFF
            bool "Off (water only)"

    endchoice

    config RADIO_OCTOPUS_FRAME_MS
        int "Octopus frame interval (ms)"
        range 33 250
        default 80
        help
            Time between octopus frames. 80 is about 12 frames per second. Raise
            it to leave more CPU for audio and Wi-Fi, lower it for smoother motion.

endmenu
```

## sdkconfig.defaults
```kconfig
CONFIG_IDF_TARGET="esp32c3"
CONFIG_COMPILER_OPTIMIZATION_PERF=y
CONFIG_COMPILER_OPTIMIZATION_ASSERTIONS_ENABLE=y

CONFIG_ESPTOOLPY_FLASHSIZE_8MB=y
CONFIG_ESPTOOLPY_HEADER_FLASHSIZE_UPDATE=y
CONFIG_PARTITION_TABLE_CUSTOM=y
CONFIG_PARTITION_TABLE_CUSTOM_FILENAME="partitions.csv"

CONFIG_ESP_CONSOLE_USB_SERIAL_JTAG=y
CONFIG_ESP_CONSOLE_SECONDARY_NONE=y

CONFIG_LV_COLOR_DEPTH_16=y
CONFIG_LV_FONT_MONTSERRAT_14=y
CONFIG_LV_FONT_MONTSERRAT_20=y
CONFIG_LV_MEM_SIZE_KILOBYTES=23
CONFIG_ESP_SYSTEM_EVENT_TASK_STACK_SIZE=4096

CONFIG_FREERTOS_HZ=200

CONFIG_AUDIO_DECODER_MP3_SUPPORT=y
# The screenshot protocol redraws through the display flush callback and does
# not use LVGL's snapshot widget.
# CONFIG_LV_USE_SNAPSHOT is not set

# This UI is built from objects, labels and one bar. Disabling LVGL's unused
# widget implementations reduces Flash pressure without changing those widgets.
# CONFIG_LV_USE_ANIMIMG is not set
# CONFIG_LV_USE_ARC is not set
# CONFIG_LV_USE_ARCLABEL is not set
# CONFIG_LV_USE_BUTTON is not set
# CONFIG_LV_USE_BUTTONMATRIX is not set
# CONFIG_LV_USE_CALENDAR is not set
# CONFIG_LV_USE_CANVAS is not set
# CONFIG_LV_USE_CHART is not set
# CONFIG_LV_USE_CHECKBOX is not set
# CONFIG_LV_USE_DROPDOWN is not set
# CONFIG_LV_USE_IMAGE is not set
# CONFIG_LV_USE_IMAGEBUTTON is not set
# CONFIG_LV_USE_KEYBOARD is not set
# CONFIG_LV_USE_LED is not set
# CONFIG_LV_USE_LINE is not set
# CONFIG_LV_USE_LIST is not set
# CONFIG_LV_USE_MENU is not set
# CONFIG_LV_USE_MSGBOX is not set
# CONFIG_LV_USE_ROLLER is not set
# CONFIG_LV_USE_SCALE is not set
# CONFIG_LV_USE_SLIDER is not set
# CONFIG_LV_USE_SPAN is not set
# CONFIG_LV_USE_SPINBOX is not set
# CONFIG_LV_USE_SPINNER is not set
# CONFIG_LV_USE_SWITCH is not set
# CONFIG_LV_USE_TABLE is not set
# CONFIG_LV_USE_TABVIEW is not set
# CONFIG_LV_USE_TEXTAREA is not set
# CONFIG_LV_USE_TILEVIEW is not set
# CONFIG_LV_USE_WIN is not set
# CONFIG_LV_BUILD_EXAMPLES is not set
# CONFIG_LV_BUILD_DEMOS is not set
# CONFIG_AUDIO_DECODER_AAC_SUPPORT is not set
# CONFIG_AUDIO_DECODER_G711_SUPPORT is not set
# CONFIG_AUDIO_DECODER_AMRNB_SUPPORT is not set
# CONFIG_AUDIO_DECODER_AMRWB_SUPPORT is not set
# CONFIG_AUDIO_DECODER_FLAC_SUPPORT is not set
# CONFIG_AUDIO_DECODER_OPUS_SUPPORT is not set
# CONFIG_AUDIO_DECODER_VORBIS_SUPPORT is not set
# CONFIG_AUDIO_DECODER_ADPCM_SUPPORT is not set
# CONFIG_AUDIO_DECODER_ALAC_SUPPORT is not set
# CONFIG_AUDIO_DECODER_PCM_SUPPORT is not set
# CONFIG_AUDIO_DECODER_SBC_SUPPORT is not set
# CONFIG_AUDIO_DECODER_LC3_SUPPORT is not set
# CONFIG_AUDIO_DECODER_G722_SUPPORT is not set
# CONFIG_AUDIO_SIMPLE_DEC_WAV_SUPPORT is not set
# CONFIG_AUDIO_SIMPLE_DEC_M4A_SUPPORT is not set
# CONFIG_AUDIO_SIMPLE_DEC_TS_SUPPORT is not set
# CONFIG_AUDIO_SIMPLE_DEC_OGG_SUPPORT is not set

CONFIG_MBEDTLS_CERTIFICATE_BUNDLE=y
CONFIG_MBEDTLS_CERTIFICATE_BUNDLE_DEFAULT_FULL=y

CONFIG_HTTPD_MAX_REQ_HDR_LEN=1024
CONFIG_HTTPD_MAX_URI_LEN=256

CONFIG_ESP_WIFI_STATIC_RX_BUFFER_NUM=4
CONFIG_ESP_WIFI_DYNAMIC_RX_BUFFER_NUM=8
CONFIG_ESP_WIFI_DYNAMIC_TX_BUFFER_NUM=8
CONFIG_ESP_WIFI_RX_BA_WIN=6
CONFIG_ESP_WIFI_MGMT_SBUF_NUM=8
CONFIG_ESP_WIFI_RX_MGMT_BUF_NUM_DEF=5
CONFIG_ESP_WIFI_ENABLE_WPA3_SAE=n

# CONFIG_BT_ENABLED is not set
```
